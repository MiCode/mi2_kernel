## drivers/video/mhl/Kconfig
```kconfig
#
# HDMI to MHL  device configuration
#

menu "MHL sii9244 support"


config FB_MSM_HDMI_MHL_9244
	tristate "FB_MSM_HDMI_MHL_9244"
	default n
	help
	  If you say yes here you get support for the MHL_Sii9244 transimitter.

	  This driver can also be built as a module.  If so, the module
	  will be called sii9244.

config FB_MSM_HDMI_MHL_RCP
	bool "FB_MSM_HDMI_MHL_RCP"
	depends on FB_MSM_HDMI_MHL_9244
	default n
	help

endmenu
```
